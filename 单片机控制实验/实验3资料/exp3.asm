$NOMOD51
$INCLUDE (8051.MCU)

;====================================================================
; 定义
;====================================================================
SHCP EQU P1.1 ; 移位输入时钟
STCP EQU P1.2 ; 写入时钟
DATAS EQU P1.3 ; 数据线
;====================================================================
; 变量
;====================================================================

;====================================================================
; 复位和中断向量
;====================================================================

; 复位向量
org 0000h
jmp Start

;====================================================================
; 代码段
;====================================================================
org 0100h
; 符号数据
; 每个字表示为16*16的点阵（亮/暗），一共256bit = 32 Byte
; 而一共有16行，因此每行其实就是 2 Byte
CHARACTER:
DB 020H,040H,03FH,07EH,048H,090H,085H,008H,03FH,0F8H,001H,008H,001H,008H,03FH,0F8H;
DB 021H,000H,021H,000H,03FH,0FCH,003H,004H,005H,004H,019H,028H,0E1H,010H,001H,000H;"第",0

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DB 041H,008H,0F9H,0F8H,041H,008H,001H,008H,019H,008H,0E1H,008H,047H,0FEH,000H,000H;"组",3

Start:    
    ; 初始化代码

    MOV DPTR, #CHARACTER ; 将数据指针DPTR设置为CHARACTER的地址
    MOV R0,#0 ; 初始化行值
    MOV A,#0 ; 初始化累加器A

MAIN:
    ; 主程序循环
    PUSH ACC ; 保存累加器A的当前值
    CALL WRITE_BYTE ; 调用WRITE_BYTE子程序
    POP ACC ; 恢复累加器A的值
    
    INC A ; 增加A的值
    INC A


    CJNE A,#128,MAIN ; 如果A不等于128则继续循环
    MOV A,#0 ; 如果A等于128则重置A为0

    jmp MAIN ; 无条件跳转到MAIN

; 写字节子程序
WRITE_BYTE:
    MOV R6,#16 ; 初始化行计数器R6为16
    MOV R0,#0 ; 初始列地址为0
    
ROW:

COL:
    MOV R7,#8 ; 初始化列计数器R7为8
    PUSH ACC ; 保存累加器A的当前值
    MOVC A,@A+DPTR ; 从内存指针DPTR指定的位置取数据
    
    ; 处理列的第一个字节
COL1:
    RLC A ; 循环移位A中的位
 ;将 A 和进位标志一起向左循环移位 1 位。位 7 移入 CY,CY 移入位 0。不影 响标志
    CLR SHCP ; 清除移位输入时钟
    MOV DATAS, C ; 将累加器C的值送入数据线
    SETB SHCP ; 设置移位输入时钟
    DJNZ R7, COL1 ; 如果R7不等于0则继续列处理循环
    
    MOV R7,#8 ; 重新初始化列计数器R7为8
    POP ACC ; 恢复累加器A的值
 ; 增加A的值，获得第二个字节
    INC A
    PUSH ACC ; 保存累加器A的当前值
    MOVC A,@A+DPTR ; 从内存指针DPTR指定的位置取数据

    ; 处理列的第二个字节
COL2:
    RLC A ; 循环移位A中的位
    CLR SHCP ; 清除移位输入时钟
    MOV DATAS, C ; 将累加器C的值送入数据线
    SETB SHCP ; 设置移位输入时钟
    DJNZ R7, COL2 ; 如果R7不等于0则继续列处理循环

;STCP上升沿将移位寄存器的数据锁存到输出寄存器
    CLR STCP ; 清除写入时钟
    NOP ; 空操作
    SETB STCP ; 设置写入时钟

    POP ACC ; 恢复累加器A的值
    INC A ; 增加A的值
    CJNE A,#128,HuanHang ; 如果A不等于128则跳转到HuanHang
    MOV A,#0 ; 如果A等于128则重置A为0，从头开始显示

HuanHang:
    ; 切换到下一行，并调用延迟子程序
    CALL DELAY ; 调用延迟子程序
    
;P2连接两块74LS138，用于控制输出的行
    PUSH ACC ; 保存累加器A的当前值
    MOV A,R0 ; 将当前行号赋值给P2端口
    MOV P0,A ; 输出行地址
    POP ACC ; 恢复累加器A的值
    
    INC R0 ; 增加R0（行计数器）的值
    DJNZ R6, ROW ; 如果R6不等于0则继续行处理循环
    
    RET ; 返回上一级调用

; 延迟子程序
DELAY:
    MOV R4, #140 ; 延迟时间计数器初始化

DELAY_1:
    MOV R5, #10 ; 内层延迟计数器初始化
    DJNZ R5, $ ; 一直循环直到R5达到0
    DJNZ R4, DELAY_1 ; 循环内层延迟，直到R4达到0
    RET ; 返回上一级调用

;====================================================================
END